## hps/yocto/meta-altera-fpga-coredla/conf/layer.conf
```bitbake
BBPATH .= ":${LAYERDIR}"

BBFILES += "${LAYERDIR}/recipes-*/*/*.bb"
BBFILES += "${LAYERDIR}/recipes-*/*/*.bbappend"

BBFILE_COLLECTIONS += "meta-altera-fpga-coredla"
BBFILE_PATTERN_meta-altera-fpga-coredla = "^${LAYERDIR}/"
BBFILE_PRIORITY_meta-altera-fpga-coredla = "5"

LAYERDEPENDS_meta-altera-fpga-coredla = "core"
LAYERSERIES_COMPAT_meta-altera-fpga-coredla = "walnascar"

KERNEL_PROVIDER = "linux-socfpga-lts"
PREFERRED_VERSION_linux-socfpga-lts = "6.12.33%"

PREFERRED_VERSION_u-boot-socfpga = "v2025.07%"

ALTERA_FPGA_FIRMWARE ??= '0'
```
